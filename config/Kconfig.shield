## config/Kconfig.shield
```kconfig
# Copyright (c) 2020 Pete Johanson
# SPDX-License-Identifier: MIT

config SHIELD_ALGEBOARD_LEFT
    def_bool $(shields_list_contains,algeboard_left)

config SHIELD_ALGEBOARD_RIGHT
    def_bool $(shields_list_contains,algeboard_right)
```

## config/west.yml
```yaml
manifest:
  remotes:
    - name: zmkfirmware
      url-base: https://github.com/algeboard
  projects:
    - name: zmk
      remote: zmkfirmware
      revision: test
      import: app/west.yml
  self:
    path: config
```
